## drivers/Kconfig
```kconfig
# Copyright (c) 2024 Arribada Initiative CIC
# SPDX-License-Identifier: MIT

menu "Drivers"
rsource "rtc/Kconfig.ds3231"
endmenu
```

## drivers/rtc/Kconfig.ds3231
```kconfig
config RTC_DS3231
       bool "DS3231 RTC driver"
       default y
       depends on DT_HAS_ANALOGDEVICES_DS3231_ENABLED
       select I2C

if RTC_ALARM || RTC_UPDATE
config RTC_DS3231_THREAD_STACK_SIZE
	int "Stack size for the DS3231 interrupt thread"
	default 512
	help
	  Size of the stack used for the thread handling interrupts and dispatching callbacks.

config RTC_DS3231_THREAD_PRIO
	int "Priority for the DS3231 interrupt thread"
	default 0
	help
	  Priority level for the thread handling interrupts and dispatching callbacks.

endif # RTC_ALARM || RTC_UPDATE
```

## dts/bindings/rtc/adi,ds3231.yaml
```yaml
description: |
  DS3231 as a RTC device

compatible: "adi,ds3231"

include:
  - name: rtc-device.yaml
  - name: i2c-device.yaml

properties:
  int1-gpios:
    type: phandle-array
    description: |
      GPIO connected to the DS3231 INT1 interrupt output. This signal is open-drain, active low.
```

## dts/bindings/rtc/analogdevices,ds3231.yaml
```yaml
description: |
  DS3231 as a RTC device

compatible: "analogdevices,ds3231"

include:
  - name: i2c-device.yaml
  - name: rtc-device.yaml
```

## dts/bindings/sensor/vishay,veml7700.yaml
```yaml
description: |
  VEML7700 16-bit ambient light sensor

compatible: "vishay,veml7700"
include: [base.yaml, i2c-device.yaml]
```
